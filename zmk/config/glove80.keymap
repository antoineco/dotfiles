#include <behaviors.dtsi>
#include <dt-bindings/zmk/keys.h>
#include <dt-bindings/zmk/bt.h>
#include <dt-bindings/zmk/outputs.h>
#include <dt-bindings/zmk/rgb.h>
#include <dt-bindings/zmk/ext_power.h>

#include <zmk-helpers/helper.h>
#include <zmk-helpers/key-labels/glove80.h>

#include "mouse.h"

#define KEYS_L LT0 LT1 LT2 LT3 LT4 LM0 LM1 LM2 LM3 LM4 LM5 LB0 LB1 LB2 LB3 LB4 LH0 LH1 LH2
#define KEYS_R RT0 RT1 RT2 RT3 RT4 RM0 RM1 RM2 RM3 RM4 RM5 RB0 RB1 RB2 RB3 RB4 RH0 RH1 RH2

#include "keymap.dtsi"

#define MAGI 6

MAKE_LAYER_TAP(magic, "Magic", &macro_rgb_sta)  /* must use macro as 2nd binding because RGB_STATUS expands to 2 params */
ZMK_MACRO(macro_rgb_sta, bindings = <&rgb_ug RGB_STATUS>;)

#define MAGIC &magic MAGI 0x0 /* second arg irrelevant due to usage of macro binding */

MAKE_BT_TAP_DANCE(3)

#define RM_SPI &rgb_ug RGB_SPI
#define RM_SPD &rgb_ug RGB_SPD
#define RM_SAI &rgb_ug RGB_SAI
#define RM_SAD &rgb_ug RGB_SAD
#define RM_HUI &rgb_ug RGB_HUI
#define RM_HUD &rgb_ug RGB_HUD
#define RM_BRI &rgb_ug RGB_BRI
#define RM_BRD &rgb_ug RGB_BRD
#define RM_TOG &rgb_ug RGB_TOG
#define RM_EFF &rgb_ug RGB_EFF

/* Base (default), Graphite alphas
 */
GLV80_LAYER(Default,
  &none        &none        &none        &none        &none                                    &none        &none        &none        &none        &none
  &none        &none        &none        &none        &none        &none          &none        &none        &none        &none        &none        &none
  &none        &kp B        &kp L        &kp D        &kp W        &kp Z          &sqtundr     &kp F        &kp O        &kp U        &kp J        &none
  &kp ESC      HM_N         HM_R         HM_T         HM_S         &kp G          &kp Y        HM_H         HM_A         HM_E         HM_I         &kp FSLH
  &none        &kp Q        &kp X        &kp M        &kp C        &kp V        , &kp K        &kp P        &dotcolon    &mindqt      &commsemi    &none
  MAGIC        &none        &none        &none        &none                     ,              &none        &none        &none        &none        &none
                                                                                ,
                                      &kp PSCRN    &none        &none                &none        &none        &none,
                                      BSPC_UPPR    DEL_MEDI     &kp PAUSE_BREAK      &kp INS      RET_FUNC     SPC_LOWR
)

/* Numbers, Navigation
 */
GLV80_LAYER(Lower,
  &none        &none        &none        &none        &none                                    &none        &none        &none        &none        &none
  &none        &none        &none        &none        &none        &none          &none        &none        &none        &none        &none        &none
  &none        &kp KP_MINUS &kp N7       &kp N8       &kp N9       &kp KP_PLUS    &kp PRCNT    &kp LBKT     &kp LPAR     &kp RPAR     &kp RBKT     &none
  &kp COLON    &kp N0       &kp N4       &kp N5       &kp N6       &kp KP_EQUAL   &kp LEFT     &kp DOWN     &kp UP       &kp RIGHT    &kp KP_DOT   &kp B
  &none        &kp KP_SLASH &kp N1       &kp N2       &kp N3       &kp KP_ASTERISK,&kp HOME    &kp PG_DN    &kp PG_UP    &kp END      &kp X        &none
  &none        &none        &none        &none        &none                     ,              &none        &none        &none        &none        &none
                                                                                ,
                                         &none        &none        &none          &none        &none        &none,
                                         &trans       &trans       &none          &none        &none        &none
)

/* Symbols
 */
GLV80_LAYER(Upper,
  &none        &none        &none        &none        &none                                    &none        &none        &none        &none        &none
  &none        &none        &none        &none        &none        &none          &none        &none        &none        &none        &none        &none
  &none        &kp TILDE    &kp DOT      &kp ASTRK    &kp AMPS     &kp AT         &kp PRCNT    &kp LBKT     &kp LPAR     &kp RPAR     &kp RBKT     &none
  &kp UNDER    &kp LT       &kp PIPE     &kp MINUS    &kp GT       &kp FSLH       &kp EXCL     &kp COMMA    &kp LBRC     &kp RBRC     &kp SEMI     &kp QMARK
  &none        &kp GRAVE    &kp SQT      &kp DQT      &kp PLUS     &kp BSLH     , &kp HASH     &kp CARET    &kp COLON    &kp EQUAL    &kp DLLR     &none
  &none        &none        &none        &none        &none                     ,              &none        &none        &none        &none        &none
                                                                                ,
                                         &none        &none        &none          &none        &none        &none,
                                         &none        &none        &none          &none        &trans       &trans
)

/* Mouse
 */
GLV80_LAYER(Adjust,
  &none        &none        &none        &none        &none                                    &none        &none        &none        &none        &none
  &none        &none        &none        &none        &none        &none          &none        &none        &none        &none        &none        &none
  &none        &none        &none        &none        &none        &none          &none        &none        &none        &none        &none        &none
  &none        &none        &none        &mkp MB2     &mkp MB1     &none          MMV_LEFT     MMV_DOWN     MMV_UP       MMV_RGHT     &none        &none
  &none        &none        &none        &none        &none        &none        , MSC_LEFT     MSC_DOWN     MSC_UP       MSC_RGHT     &none        &none
  &none        &none        &none        &none        &none                     ,              &none        &none        &none        &none        &none
                                                                                ,
                                         &none        &none        &none          &none        &none        &none,
                                         &none        &none        &none          &none        &none        &none
)

/* Function keys
 */
GLV80_LAYER(Function,
  &none        &none        &none        &none        &none                                    &none        &none        &none        &none        &none
  &none        &none        &none        &none        &none        &none          &none        &none        &none        &none        &none        &none
  &none        &kp F12      &kp F7       &kp F8       &kp F9       &none          &none        &kp F19      &kp F20      &kp F21      &kp F24      &none
  &none        &kp F11      &kp F4       &kp F5       &kp F6       &none          &none        &kp F16      &kp F17      &kp F18      &kp F23      &none
  &none        &kp F10      &kp F1       &kp F2       &kp F3       &none        , &none        &kp F13      &kp F14      &kp F15      &kp F22      &none
  &none        &none        &none        &none        &none                     ,              &none        &none        &none        &none        &none
                                                                                ,
                                         &none        &none        &none          &none        &none        &none,
                                         &none        &none        &none          &none        &none        &none
)

/* Media, One-shot modifiers
 */
GLV80_LAYER(Media,
  &none        &none        &none        &none        &none                                    &none        &none        &none        &none        &none
  &none        &none        &none        &none        &none        &none          &none        &none        &none        &none        &none        &none
  &none        &none        &none        &none        &none        &none          &none        &kp C_PREV   &kp C_PP     &kp C_NEXT   &none        &none
  &none        &sk LGUI     &sk LALT     &sk LCTRL    &sk LSHFT    &none          &none        &kp C_MUTE   &kp C_VOL_DN &kp C_VOL_UP &none        &none
  &none        &none        &none        &none        &none        &none        , &none        &none        &none        &none        &none        &none
  &none        &none        &none        &none        &none                     ,              &none        &none        &none        &none        &none
                                                                                ,
                                         &none        &none        &none          &none        &none        &none,
                                         &none        &none        &none          &none        &none        &none
)

/* Keyboard control
 */
GLV80_LAYER(Magic,
  &bt BT_CLR   &none        &none        &none        &none                                    &none        &none        &none        &none        &bt BT_CLR_ALL
  &none        &none        &none        &none        &none        &none          &none        &none        &none        &none        &none        &none
  &none        RM_SPI       RM_SAI       RM_HUI       RM_BRI       RM_TOG         &none        &none        &none        &none        &none        &none
  &none        RM_SPD       RM_SAD       RM_HUD       RM_BRD       RM_EFF         &none        &none        &none        &none        &none        &none
  &none        &none        &none        &none        &none        &none        , &none        &none        &none        &none        &none        &none
  &none        &none        &none        &none        &none                     ,              &none        &none        &none        &none        &none
                                                                                ,
                                         &bt2         &bt3         &none          &none        &none        &none,
                                         &bt0         &bt1         &out OUT_USB   &none        &none        &none
)
