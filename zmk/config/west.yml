## zmk/config/west.yml
```yaml
manifest:
  defaults:
    revision: v0.3
  remotes:
    - name: zmkfirmware
      url-base: https://github.com/zmkfirmware
    - name: antoineco
      url-base: https://github.com/antoineco
    - name: urob
      url-base: https://github.com/urob
  projects:
    - name: zmk
      remote: zmkfirmware
      import: app/west.yml
    - name: zmk-keyboard-totem
      remote: antoineco
    - name: zmk-helpers
      remote: urob

    # Only import necessary Zephyr modules.
    # Override for https://github.com/zmkfirmware/zmk/blob/v0.3/app/west.yml#L8-L31
    - name: zephyr
      remote: zmkfirmware
      revision: v3.5.0+zmk-fixes
      clone-depth: 1
      import:
        name-allowlist:
          - cmsis
          - hal_nordic
          - lvgl
          - tinycrypt

  self:
    path: config
```
